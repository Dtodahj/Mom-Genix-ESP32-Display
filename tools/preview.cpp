#include "renderer.h"
#include <vector>
#include <string>
#include <fstream>
#include <stdio.h>
#include <stdlib.h>
using namespace momgenix;
struct Raster : Canvas {
  std::vector<uint16_t> pixels = std::vector<uint16_t>(kWidth*kHeight);
  void rect(int x, int y, int w, int h, uint16_t color) override {
    if (x < 0 || y < 0 || x+w > kWidth || y+h > kHeight) { fprintf(stderr,"Clipped drawing\n"); exit(1); }
    for (int yy = y; yy < y+h; ++yy) for (int xx = x; xx < x+w; ++xx) pixels[yy*kWidth+xx] = color;
  }
  void save(const std::string& name) {
    std::ofstream out(name, std::ios::binary); out << "P6\n320 240\n255\n";
    for (auto p : pixels) {
      unsigned char rgb[] = {static_cast<unsigned char>(((p>>11)&31)*255/31),
                            static_cast<unsigned char>(((p>>5)&63)*255/63),
                            static_cast<unsigned char>((p&31)*255/31)};
      out.write(reinterpret_cast<const char*>(rgb),3);
    }
    if (!out) exit(1);
  }
};
int main(int argc, char** argv) {
  if (argc != 2) return 1;
  Raster canvas; Renderer renderer(canvas); StateMachine state;
  const std::string dir = argv[1];
  renderer.update(state, 0); canvas.save(dir + "/startup.ppm");
  for (size_t i = 0; i < kMessageCount; ++i) {
    uint32_t now = 3000 + static_cast<uint32_t>(i)*7000;
    state.tick(now,0); renderer.update(state,now);
    if (!renderer.layoutFits()) return 2;
    char filename[32]; snprintf(filename,sizeof(filename),"/message_%02u.ppm",static_cast<unsigned>(i+1));
    canvas.save(dir + filename);
    printf("%02u %-16s heading=%zu lines body=%zu lines at %dpx\n", static_cast<unsigned>(i+1),
           kMessages[i].heading, wrap(kMessages[i].heading,kTextWidth/(6*kHeadingScale)).count,
           wrap(kMessages[i].body,kTextWidth/(6*kBodyScale)).count, kBodyScale*8);
  }
  state.tick(67000,1000); state.tick(67050,1000); state.tick(69000,1000);
  renderer.update(state,69000); canvas.save(dir + "/paused.ppm");
  printf("Preview generated by the actual firmware renderer, font, content and layout.\n");
}
